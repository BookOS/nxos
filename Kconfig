## Kconfig
```kconfig
mainmenu "NXOS(Next XBook Operating System) Configuration"

config NXOS_SRC_DIR
    string
    option env="NXOS_SRC_DIR"
    default "./src"

source "$NXOS_SRC_DIR/Kconfig"
```

## src/Kconfig
```kconfig
#
# Kconfig for NXOS source code.
#

#
# CPU 64 bits width
#
config NX_CPU_64BITS
    bool 
    default n

menu "OS Kernel"
    #
    # Kernel
    #
    source "$NXOS_SRC_DIR/kernel/Kconfig"
    
    #
    # Init
    #
    source "$NXOS_SRC_DIR/init/Kconfig"

    #
    # IO
    #
    source "$NXOS_SRC_DIR/io/Kconfig"
    
    #
    # IPC
    #
    source "$NXOS_SRC_DIR/ipc/Kconfig"
    
    #
    # MM
    #
    source "$NXOS_SRC_DIR/mm/Kconfig"

    #
    # Sched
    #
    source "$NXOS_SRC_DIR/sched/Kconfig"

    #
    # Process
    #
    source "$NXOS_SRC_DIR/process/Kconfig"    
    
    #
    # Time or timer
    #
    source "$NXOS_SRC_DIR/time/Kconfig"
endmenu

#
# platfrom config
#
menu "Platform"
    source "$NXOS_SRC_DIR/platform/Kconfig"
endmenu

#
# Device
#
menu "Device"
    source "$NXOS_SRC_DIR/drivers/Kconfig"
endmenu

#
# File system
#
menu "File System"
    source "$NXOS_SRC_DIR/fs/Kconfig"
endmenu

#
# Test framework and test code
#
menu "Tests"
    source "$NXOS_SRC_DIR/test/Kconfig"
endmenu
```

## src/drivers/Kconfig
```kconfig
source "$NXOS_SRC_DIR/drivers/console/Kconfig"
source "$NXOS_SRC_DIR/drivers/block/Kconfig"

config NX_DRIVER_DUMMY
    bool "Enable dummy device"
    default n

config NX_DRIVER_NULL
    bool "Enable null device"
    default y

config NX_DRIVER_ZERO
    bool "Enable zero device"
    default y

config NX_DRIVER_MEMINFO
    bool "Enable memory info device"
    default y
```

## src/drivers/block/Kconfig
```kconfig
config NX_DRIVER_ROMDISK
    bool "Enable romdisk device"
    default n
if NX_DRIVER_ROMDISK
    config NX_DRIVER_ROMDISK_HOSTOS_PATH
        string "Romdisk file on hostos"
        default "../../romdisk.cpio"
endif
```

## src/drivers/console/Kconfig
```kconfig
config NX_DRIVER_CONSOLE
    bool "Enable console device"
    default y

config NX_PRINT_BUF_LEN
    int "printf buffer length"
    default 256
```

## src/fs/Kconfig
```kconfig
source "$NXOS_SRC_DIR/fs/cpio/Kconfig"
source "$NXOS_SRC_DIR/fs/devfs/Kconfig"

config NX_ENABLE_EXECUTE_USER
    bool "Enable execute first user process"
    select NX_ENABLE_MOUNT_TABLE
    default n

    if NX_ENABLE_EXECUTE_USER
    
        config NX_FIRST_USER_PATH
            string "first user process file path"
            default "/uinit"

    endif

config NX_ENABLE_MOUNT_TABLE
    bool "Enable default mount table"
    default n

    if NX_ENABLE_MOUNT_TABLE
        config NX_MOUNT_DEVICE_DEFAULT
            string "default mount device"
            default "romdisk0"

        config NX_MOUNT_PATH_DEFAULT
            string "default mount root path"
            default "/"

        config NX_MOUNT_FSNAME_DEFAULT
            string "default mount fsname"
            default "cpio"
            
        if NX_FS_DEVFS
            config NX_DEVFS_PATH_DEFAULT
                string "default devfs mount path"
                default "/dev"

            config NX_DEVFS_FSNAME_DEFAULT
                string "default devfs fsname"
                default "devfs"
        endif

    endif

config NX_VFS_MAX_PATH
    int "vfs max path length" 
    default 512

config NX_VFS_MAX_NAME
    int "vfs max name length" 
    default 256

config NX_VFS_MAX_FD
    int "vfs max file descriptor number" 
    default 256

config NX_VFS_NODE_HASH_SIZE
    int "vfs max node hash list size" 
    default 256
```

## src/fs/cpio/Kconfig
```kconfig
config NX_FS_CPIO
    bool "Enable cpio file system"
    select NX_DRIVER_ROMDISK
    default n
```

## src/init/Kconfig
```kconfig
config NX_PLATFORM_NAME
    string "Platform name"
    default "Unknown"

#
# CPU numbers
#
config NX_MULTI_CORES_NR
    int "platform CPU core numbers"
    default 1

config NX_ENABLE_PLATFORM_MAIN
    bool "Enable call platform main"
    default y
```

## src/kernel/Kconfig
```kconfig
menu "Debug"
config NX_DEBUG
    bool "Debug NXOS before release"
    default y

if NX_DEBUG
    config NX_LOG_LEVEL
        int "Log level(0: ERROR, 1: WARNING, 2: INFO, 3: DBG)"
        default 3

    config NX_DEBUG_COLOR
        bool "Log output with color"
        default y

    config NX_DEBUG_TIMELINE
        bool "Log output with timeline"
        default y

    config NX_DEBUG_LINENUMBER
        bool "Log output with file line number"
        default n

endif
endmenu
```

## src/mods/Kconfig
```kconfig
menu "Console"
    source "$NXOS_SRC_DIR/mods/console/Kconfig"
endmenu

menu "Time"
    source "$NXOS_SRC_DIR/mods/time/Kconfig"
endmenu

menu "Drivers"
    source "$NXOS_SRC_DIR/mods/drivers/Kconfig"
endmenu

menu "Test"
    source "$NXOS_SRC_DIR/mods/test/Kconfig"
endmenu

menu "Demo"
    source "$NXOS_SRC_DIR/mods/demo/Kconfig"
endmenu

menu "Thirdpart"
    source "$NXOS_SRC_DIR/mods/thirdpart/Kconfig"
endmenu

menu "File System"
    source "$NXOS_SRC_DIR/mods/fs/Kconfig"
endmenu
```

## src/platform/i386/defconfig
```kconfig
#
# OS Kernel
#

#
# Debug
#
CONFIG_NX_DEBUG=y
CONFIG_NX_LOG_LEVEL=3
CONFIG_NX_DEBUG_COLOR=y
CONFIG_NX_DEBUG_TIMELINE=y
# CONFIG_NX_DEBUG_LINENUMBER is not set
# end of Debug

CONFIG_NX_PLATFORM_NAME="x86-i386"
CONFIG_NX_MULTI_CORES_NR=1
CONFIG_NX_ENABLE_PLATFORM_MAIN=y
CONFIG_NX_IRQ_NAME_LEN=48
CONFIG_NX_NR_IRQS=16
CONFIG_NX_KVADDR_OFFSET=0x00000000
CONFIG_NX_PAGE_SHIFT=12
CONFIG_NX_MAX_THREAD_NR=256
CONFIG_NX_THREAD_NAME_LEN=32
CONFIG_NX_THREAD_STACK_SIZE=8192
CONFIG_NX_ENABLE_SCHED=y
CONFIG_NX_THREAD_MAX_PRIORITY_NR=16
CONFIG_NX_TICKS_PER_SECOND=100
# end of OS Kernel

#
# Platform
#
CONFIG_NX_PLATFORM_I386_PC32=y
# end of Platform

#
# Device
#
CONFIG_NX_PRINT_BUF_LEN=256
# CONFIG_NX_DRIVER_ROMDISK is not set
# CONFIG_NX_DRIVER_DUMMY is not set
CONFIG_NX_DRIVER_NULL=y
CONFIG_NX_DRIVER_ZERO=y
# end of Device

#
# File System
#
# CONFIG_NX_FS_CPIO is not set
# CONFIG_NX_FS_DEVFS is not set
# CONFIG_NX_ENABLE_EXECUTE_USER is not set
# CONFIG_NX_ENABLE_MOUNT_TABLE is not set
CONFIG_NX_VFS_MAX_PATH=512
CONFIG_NX_VFS_MAX_NAME=256
CONFIG_NX_VFS_MAX_FD=256
CONFIG_NX_VFS_NODE_HASH_SIZE=256
# end of File System

#
# Tests
#
# CONFIG_NX_ENABLE_TEST_UTEST is not set
# CONFIG_NX_ENABLE_TEST_INTEGRATION is not set
# end of Tests
```

## src/platform/qemu_riscv64/Kconfig
```kconfig
config NX_PLATFORM_RISCV64_QEMU
    bool
    default y
    select NX_CPU_64BITS

config NX_UART0_FROM_SBI
    bool "Uart0 get/set from SBI"
    default n
```

## src/sched/Kconfig
```kconfig
config NX_MAX_THREAD_NR
    int "Max thread numbers"
    default 256

config NX_THREAD_NAME_LEN
    int "thread name length"
    default 32

config NX_THREAD_STACK_SIZE
    int "default thread stack size (bytes)"
    default 4096

config NX_ENABLE_SCHED
    bool "Enable thread scheduler"
    default n

config NX_THREAD_MAX_PRIORITY_NR
    int "Max thread priority numbers"
    default 16
```

## src/test/Kconfig
```kconfig
config NX_ENABLE_TEST_UTEST
    bool "Enable utest test"
    default n
    
    if NX_ENABLE_TEST_UTEST
        source "$NXOS_SRC_DIR/test/utests/Kconfig"
    endif

config NX_ENABLE_TEST_INTEGRATION
    bool "Enable integration test"
    default n

    if NX_ENABLE_TEST_INTEGRATION
        source "$NXOS_SRC_DIR/test/integrations/Kconfig"
    endif
```

## src/test/integrations/Kconfig
```kconfig
source "$NXOS_SRC_DIR/test/integrations/mm/Kconfig"
source "$NXOS_SRC_DIR/test/integrations/time/Kconfig"
source "$NXOS_SRC_DIR/test/integrations/sched/Kconfig"
source "$NXOS_SRC_DIR/test/integrations/utils/Kconfig"
source "$NXOS_SRC_DIR/test/integrations/xbook/Kconfig"
```

## src/test/integrations/sched/Kconfig
```kconfig
config NX_TEST_INTEGRATION_THREAD
    bool "Enable integration for thread"
    default n

config NX_TEST_INTEGRATION_THREAD_ID
    bool "Enable integration for thread id"
    default n
```

## src/test/integrations/time/Kconfig
```kconfig
config NX_TEST_INTEGRATION_TIMER
    bool "Enable integration for timer"
    default n
```

## src/test/utests/Kconfig
```kconfig
source "$NXOS_SRC_DIR/test/utests/mm/Kconfig"
source "$NXOS_SRC_DIR/test/utests/time/Kconfig"
source "$NXOS_SRC_DIR/test/utests/utest/Kconfig"
source "$NXOS_SRC_DIR/test/utests/sched/Kconfig"
source "$NXOS_SRC_DIR/test/utests/utils/Kconfig"
source "$NXOS_SRC_DIR/test/utests/xbook/Kconfig"
source "$NXOS_SRC_DIR/test/utests/io/Kconfig"
```

## src/test/utests/sched/Kconfig
```kconfig
config NX_UTEST_SCHED_MUTEX
    bool "Enable utest for mutex"
    default n

config NX_UTEST_SCHED_SPIN
    bool "Enable utest for spin"
    default n

config NX_UTEST_SCHED_SEMAPHORE
    bool "Enable utest for sempahore"
    default n

config NX_UTEST_SCHED_THREAD
    bool "Enable utest for thread"
    default n

config NX_UTEST_SCHED_PROCESS
    bool "Enable utest for process"
    default n
```
