## src/tests/integrations/mm/Kconfig
```kconfig
config NX_TEST_INTEGRATION_HEAP_CACHE
    bool "Enable integration for heap cache"
    default n

config NX_TEST_INTEGRATION_PAGE
    bool "Enable integration for page"
    default n

config NX_TEST_INTEGRATION_PAGE_CACHE
    bool "Enable integration for page cache"
    default n
```

## src/tests/utests/Kconfig
```kconfig
source "$NXOS_SRC_DIR/tests/utests/mm/Kconfig"
source "$NXOS_SRC_DIR/tests/utests/mods/Kconfig"
source "$NXOS_SRC_DIR/tests/utests/sched/Kconfig"
source "$NXOS_SRC_DIR/tests/utests/utils/Kconfig"
source "$NXOS_SRC_DIR/tests/utests/xbook/Kconfig"
source "$NXOS_SRC_DIR/tests/utests/io/Kconfig"
```
